## experiments/esp32s31-parlio/main/Kconfig.projbuild
```kconfig
menu "ProtoTracer S31 probe"
    config PROTOTRACER_HUB75_ENABLE
        bool "Enable HUB75 output after assigning board wiring"
        default n
    config PROTOTRACER_HUB75_R1
        int "R1 GPIO"
        default -1
    config PROTOTRACER_HUB75_G1
        int "G1 GPIO"
        default -1
    config PROTOTRACER_HUB75_B1
        int "B1 GPIO"
        default -1
    config PROTOTRACER_HUB75_R2
        int "R2 GPIO"
        default -1
    config PROTOTRACER_HUB75_G2
        int "G2 GPIO"
        default -1
    config PROTOTRACER_HUB75_B2
        int "B2 GPIO"
        default -1
    config PROTOTRACER_HUB75_A
        int "Address A GPIO"
        default -1
    config PROTOTRACER_HUB75_B
        int "Address B GPIO"
        default -1
    config PROTOTRACER_HUB75_C
        int "Address C GPIO"
        default -1
    config PROTOTRACER_HUB75_D
        int "Address D GPIO"
        default -1
    config PROTOTRACER_HUB75_LAT
        int "Latch GPIO"
        default -1
    config PROTOTRACER_HUB75_OE
        int "Output enable GPIO"
        default -1
    config PROTOTRACER_HUB75_CLK
        int "Clock GPIO"
        default -1
endmenu
```

## experiments/esp32s31-parlio/sdkconfig.defaults
```kconfig
CONFIG_ESP_DEFAULT_CPU_FREQ_MHZ_320=y
CONFIG_ESPTOOLPY_FLASHSIZE_16MB=y
CONFIG_ESPTOOLPY_FLASHMODE_QIO=y
CONFIG_ESPTOOLPY_FLASHFREQ_80M=y
CONFIG_SPIRAM=y
CONFIG_SPIRAM_MODE_OCT=y
CONFIG_SPIRAM_SPEED_200M=y
CONFIG_SPIRAM_USE_MALLOC=y
CONFIG_FREERTOS_HZ=1000
CONFIG_ARDUINO_VARIANT="esp32s31"
CONFIG_AUTOSTART_ARDUINO=y
CONFIG_ARDUINO_SELECTIVE_COMPILATION=y
CONFIG_HUB75_EXTERNAL_FRAMEBUFFERS=y
CONFIG_HUB75_BIT_DEPTH=8
CONFIG_BT_ENABLED=n
CONFIG_MBEDTLS_PSK_MODES=y
CONFIG_MBEDTLS_KEY_EXCHANGE_PSK=y
```
